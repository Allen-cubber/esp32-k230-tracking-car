## main/Kconfig.projbuild
```kconfig
menu "Example Configuration"

    config ESP_WIFI_SSID
        string "WiFi SSID"
        default "myssid"
        help
            SSID (network name) for the example to connect to.

    config ESP_WIFI_PASSWORD
        string "WiFi Password"
        default "mypassword"
        help
            WiFi password (WPA or WPA2) for the example to use.

    choice ESP_WIFI_SAE_MODE
        prompt "WPA3 SAE mode selection"
        default ESP_STATION_EXAMPLE_WPA3_SAE_PWE_BOTH
        help
            Select mode for SAE as Hunt and Peck, H2E or both.
        config ESP_STATION_EXAMPLE_WPA3_SAE_PWE_HUNT_AND_PECK
            bool "HUNT AND PECK"
        config ESP_STATION_EXAMPLE_WPA3_SAE_PWE_HASH_TO_ELEMENT
            bool "H2E"
            depends on ESP_WIFI_ENABLE_SAE_H2E
        config ESP_STATION_EXAMPLE_WPA3_SAE_PWE_BOTH
            bool "BOTH"
            depends on ESP_WIFI_ENABLE_SAE_H2E
    endchoice

    config ESP_WIFI_PW_ID
        string "PASSWORD IDENTIFIER"
        depends on  ESP_STATION_EXAMPLE_WPA3_SAE_PWE_HASH_TO_ELEMENT|| ESP_STATION_EXAMPLE_WPA3_SAE_PWE_BOTH
        default ""
        help
            password identifier for SAE H2E

    config ESP_MAXIMUM_RETRY
        int "Maximum retry"
        default 5
        help
            Number of failed attempts before a wait call reports failure.
            The Wi-Fi task keeps reconnecting in the background.

    config ESP_WIFI_CONNECT_TIMEOUT_MS
        int "WiFi connect wait timeout (ms)"
        range 1000 120000
        default 15000
        help
            Time to wait at startup for an IP address before the car continues
            local control tasks. Network users can still check connection state
            and wait again later.

    config DEEPSEEK_API_KEY
        string "DeepSeek API Key"
        default ""
        help
            API key used as the Bearer token for DeepSeek requests.
            This prototype stores the key in sdkconfig plaintext.

    config DEEPSEEK_API_URL
        string "DeepSeek chat completions URL"
        default "https://api.deepseek.com/chat/completions"
        help
            DeepSeek chat completions endpoint.

    config DEEPSEEK_MODEL
        string "DeepSeek model"
        default "deepseek-v4-flash"
        help
            Model name for chat completions.

    config DEEPSEEK_MAX_TOKENS
        int "DeepSeek max response tokens"
        range 16 4096
        default 256
        help
            Maximum output tokens requested from the model.

    config DEEPSEEK_TEMPERATURE
        int "DeepSeek temperature percent"
        range 0 200
        default 20
        help
            Temperature stored as percent. 20 means 0.20.

    config DEEPSEEK_THINKING_ENABLE
        bool "Enable DeepSeek thinking mode"
        default n
        help
            Enable reasoning mode. Leave disabled for lower latency car commands.

    config DEEPSEEK_REASONING_EFFORT
        string "DeepSeek reasoning effort"
        depends on DEEPSEEK_THINKING_ENABLE
        default "high"
        help
            Reasoning effort for thinking mode. DeepSeek supports high and max.

    config DEEPSEEK_REQUEST_TIMEOUT_MS
        int "DeepSeek HTTP timeout (ms)"
        range 1000 120000
        default 30000
        help
            HTTP request timeout for a DeepSeek call.

    config DEEPSEEK_WIFI_WAIT_TIMEOUT_MS
        int "DeepSeek WiFi wait timeout (ms)"
        range 1000 120000
        default 15000
        help
            Time for DeepSeek calls to wait for Wi-Fi before failing.

    config DEEPSEEK_MAX_RESPONSE_BYTES
        int "DeepSeek max HTTP response bytes"
        range 1024 65536
        default 8192
        help
            Maximum HTTP response JSON stored in RAM.

    config DEEPSEEK_BOOT_TEST_ENABLE
        bool "Enable DeepSeek boot test"
        default n
        help
            Send one test request after Wi-Fi connects and print the reply.

    config DEEPSEEK_BOOT_TEST_PROMPT
        string "DeepSeek boot test prompt"
        depends on DEEPSEEK_BOOT_TEST_ENABLE
        default "Reply with exactly: DeepSeek API connected."
        help
            Prompt sent by the optional boot test.

    config DEEPSEEK_BOOT_TEST_STACK_SIZE
        int "DeepSeek boot test task stack size"
        depends on DEEPSEEK_BOOT_TEST_ENABLE
        range 4096 24576
        default 8192
        help
            FreeRTOS stack size for the optional DeepSeek boot test task.

    config DEEPSEEK_BOOT_TEST_REPLY_BYTES
        int "DeepSeek boot test reply buffer bytes"
        depends on DEEPSEEK_BOOT_TEST_ENABLE
        range 128 4096
        default 512
        help
            Reply buffer size for the optional DeepSeek boot test.

    config AI_CONTROL_INPUT_MAX_BYTES
        int "AI control input max bytes"
        range 64 512
        default 192
        help
            Maximum text command length accepted from K230 or serial input.

    config AI_CONTROL_REPLY_MAX_BYTES
        int "AI control reply max bytes"
        range 512 4096
        default 2048
        help
            Buffer size for the DeepSeek JSON command reply.

    config AI_CONTROL_QUEUE_LEN
        int "AI control queue length"
        range 1 10
        default 3
        help
            Number of text commands that can wait for DeepSeek processing.

    config AI_CONTROL_TASK_STACK_SIZE
        int "AI control task stack size"
        range 4096 24576
        default 8192
        help
            FreeRTOS stack size for the DeepSeek command task.

    config AI_CONTROL_SERIAL_INPUT_ENABLE
        bool "Enable AI text input from serial monitor"
        default n
        help
            Read text commands from the ESP32 console for quick testing.

    config AI_CONTROL_SERIAL_TASK_STACK_SIZE
        int "AI serial input task stack size"
        depends on AI_CONTROL_SERIAL_INPUT_ENABLE
        range 2048 8192
        default 4096
        help
            FreeRTOS stack size for the optional serial input task.

    config AI_CONTROL_DEFAULT_SPEED_PERCENT
        int "AI control default speed percent"
        range 1 100
        default 35
        help
            Default chassis speed if the user does not specify one.

    config AI_CONTROL_MAX_MOTOR_SPEED
        int "AI control max motor PWM"
        range 500 8191
        default 3600
        help
            Maximum motor PWM used by AI commands. Keep this conservative while testing.

    config AI_CONTROL_MIN_DURATION_MS
        int "AI control min motion duration (ms)"
        range 50 2000
        default 200
        help
            Minimum duration for timed chassis movement commands.

    config AI_CONTROL_DEFAULT_DURATION_MS
        int "AI control default motion duration (ms)"
        range 100 10000
        default 1000
        help
            Default duration for forward/backward/turn commands.

    config AI_CONTROL_MAX_DURATION_MS
        int "AI control max motion duration (ms)"
        range 500 30000
        default 5000
        help
            Maximum duration accepted from the model for chassis or gimbal commands.

    config AI_CONTROL_GIMBAL_STEP_DEG
        int "AI control gimbal step degrees"
        range 1 60
        default 15
        help
            Default angle delta for gimbal up/down/left/right and nod/shake commands.

    config AI_CONTROL_GIMBAL_MAX_DELTA_DEG
        int "AI control gimbal max delta degrees"
        range 1 90
        default 45
        help
            Maximum gimbal angle delta accepted from the model.

    config AI_CONTROL_GIMBAL_DEFAULT_DURATION_MS
        int "AI control gimbal default duration (ms)"
        range 100 10000
        default 1200
        help
            Default duration for gimbal nod/shake animations.

    choice ESP_WIFI_SCAN_AUTH_MODE_THRESHOLD
        prompt "WiFi Scan auth mode threshold"
        default ESP_WIFI_AUTH_WPA2_PSK
        help
            The weakest authmode to accept in the scan mode.
            This value defaults to ESP_WIFI_AUTH_WPA2_PSK in case password is present and ESP_WIFI_AUTH_OPEN is used.
            Please select ESP_WIFI_AUTH_WEP/ESP_WIFI_AUTH_WPA_PSK in case AP is operating in WEP/WPA mode.

        config ESP_WIFI_AUTH_OPEN
            bool "OPEN"
        config ESP_WIFI_AUTH_WEP
            bool "WEP"
        config ESP_WIFI_AUTH_WPA_PSK
            bool "WPA PSK"
        config ESP_WIFI_AUTH_WPA2_PSK
            bool "WPA2 PSK"
        config ESP_WIFI_AUTH_WPA_WPA2_PSK
            bool "WPA/WPA2 PSK"
        config ESP_WIFI_AUTH_WPA3_PSK
            bool "WPA3 PSK"
        config ESP_WIFI_AUTH_WPA2_WPA3_PSK
            bool "WPA2/WPA3 PSK"
        config ESP_WIFI_AUTH_WAPI_PSK
            bool "WAPI PSK"
    endchoice

    config MPU6050_I2C_SDA_GPIO
        int "MPU6050 I2C SDA GPIO"
        range 0 48
        default 17
        help
            GPIO used for MPU6050 SDA. Change this to match your wiring.

    config MPU6050_I2C_SCL_GPIO
        int "MPU6050 I2C SCL GPIO"
        range 0 48
        default 18
        help
            GPIO used for MPU6050 SCL. Change this to match your wiring.

    config MPU6050_SAMPLE_PERIOD_MS
        int "MPU6050 sample period (ms)"
        range 5 100
        default 20
        help
            Read period for gyro/accel updates and yaw integration.

    config MPU6050_CALIBRATION_SAMPLES
        int "MPU6050 gyro calibration samples"
        range 100 5000
        default 500
        help
            Keep the car still at startup while averaging this many gyro samples.

    config MPU6050_GYRO_DEADBAND_DPS
        int "MPU6050 gyro deadband (0.1 dps)"
        range 0 100
        default 20
        help
            Angular rates smaller than this threshold are treated as zero.
            Value is stored in 0.1 dps units, so 20 means 2.0 dps.

    config MPU6050_BIAS_LEARN_DPS
        int "MPU6050 bias learn window (0.1 dps)"
        range 0 100
        default 30
        help
            When the measured z gyro stays within this window, the code assumes
            the car is nearly stationary and slowly updates the gyro bias.

    config MPU6050_BIAS_LEARN_ALPHA
        int "MPU6050 bias learn alpha (per mille)"
        range 1 200
        default 10
        help
            Bias tracking strength in per-mille units. 10 means 0.010.

    config K230_UART_RX_GPIO
        int "K230 UART RX GPIO"
        range 0 48
        default 10
        help
            ESP32-S3 GPIO used to receive data from K230 TX.

    config K230_UART_TX_GPIO
        int "K230 UART TX GPIO"
        range 0 48
        default 11
        help
            ESP32-S3 GPIO used to send data to K230 RX if needed later.

    config K230_UART_BAUDRATE
        int "K230 UART baudrate"
        range 9600 2000000
        default 115200
        help
            Baudrate for K230 <-> ESP32-S3 serial link.

endmenu
```

## sdkconfig.defaults
```kconfig
CONFIG_ESP_WIFI_SOFTAP_SUPPORT=n
CONFIG_ESP_WIFI_SSID="OnePlus13"
CONFIG_ESP_WIFI_PASSWORD="sukk3285"
CONFIG_ESPTOOLPY_FLASHSIZE_16MB=y
CONFIG_ESPTOOLPY_FLASHSIZE="16MB"
CONFIG_ROBOT_MQTT_BROKER_URI="mqtt://10.179.231.220:1883"
CONFIG_ROBOT_MQTT_TOPIC_ROOT="qrs"
CONFIG_ROBOT_MQTT_DEVICE_ID="robot01"
CONFIG_ROBOT_MQTT_CLIENT_ID="robot01-esp32"
CONFIG_PARTITION_TABLE_CUSTOM=y
CONFIG_PARTITION_TABLE_CUSTOM_FILENAME="partitions.csv"
CONFIG_PARTITION_TABLE_FILENAME="partitions.csv"
# CONFIG_LV_BUILD_EXAMPLES is not set
```
